## build/Kconfig/arch/Kconfig
```kconfig
# Load Zephyr Arch Kconfig descriptions.
osource "/home/glorious/programming/zephyrproject/zephyr/arch/rx/Kconfig"
osource "/home/glorious/programming/zephyrproject/zephyr/arch/x86/Kconfig"
osource "/home/glorious/programming/zephyrproject/zephyr/arch/xtensa/Kconfig"
osource "/home/glorious/programming/zephyrproject/zephyr/arch/sparc/Kconfig"
osource "/home/glorious/programming/zephyrproject/zephyr/arch/riscv/Kconfig"
osource "/home/glorious/programming/zephyrproject/zephyr/arch/posix/Kconfig"
osource "/home/glorious/programming/zephyrproject/zephyr/arch/openrisc/Kconfig"
osource "/home/glorious/programming/zephyrproject/zephyr/arch/mips/Kconfig"
osource "/home/glorious/programming/zephyrproject/zephyr/arch/arm64/Kconfig"
osource "/home/glorious/programming/zephyrproject/zephyr/arch/arm/Kconfig"
osource "/home/glorious/programming/zephyrproject/zephyr/arch/arc/Kconfig"
```

## build/Kconfig/boards/Kconfig
```kconfig
# Load Zephyr board Kconfig descriptions.
osource "/home/glorious/programming/zephyrproject/zephyr/boards/nordic/nrf52840dk/Kconfig"
```

## build/Kconfig/boards/Kconfig.defconfig
```kconfig
# Load Zephyr board defconfig descriptions.
osource "/home/glorious/programming/zephyrproject/zephyr/boards/nordic/nrf52840dk/Kconfig.defconfig"
```

## build/Kconfig/boards/Kconfig.nrf52840dk
```kconfig
# Load board Kconfig descriptions.
osource "/home/glorious/programming/zephyrproject/zephyr/boards/nordic/nrf52840dk/Kconfig.nrf52840dk"
```

## build/Kconfig/boards/Kconfig.sysbuild
```kconfig
# Load Sysbuild board Kconfig descriptions.
osource "/home/glorious/programming/zephyrproject/zephyr/boards/nordic/nrf52840dk/Kconfig.sysbuild"
```
